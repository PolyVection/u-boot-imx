## board/polyvection/coreamp1/Kconfig
```kconfig
if TARGET_COREAMP1

config SYS_BOARD
	default "coreamp1"

config SYS_SOC
	default "mx6"

config SYS_CONFIG_NAME
	default "coreamp1"

config SYS_VENDOR
	default "polyvection"


endif
```

## board/polyvection/polycore1/Kconfig
```kconfig
if TARGET_POLYCORE1

config SYS_BOARD
	default "polycore1"

config SYS_SOC
	default "mx6"

config SYS_CONFIG_NAME
	default "polycore1"

endif
```

## board/polyvection/polydsp1/Kconfig
```kconfig
if TARGET_POLYDSP1

config SYS_BOARD
	default "polydsp1"

config SYS_SOC
	default "mx6"

config SYS_CONFIG_NAME
	default "polydsp1"

config SYS_VENDOR
	default "polyvection"


endif
```

## board/polyvection/voltastream0/Kconfig
```kconfig
if TARGET_VOLTASTREAM0

config SYS_BOARD
	default "voltastream0"

config SYS_SOC
	default "mx6"

config SYS_CONFIG_NAME
	default "voltastream0"

config SYS_VENDOR
	default "polyvection"


endif
```

## configs/polycore1_defconfig
```kconfig
CONFIG_SYS_EXTRA_OPTIONS="IMX_CONFIG=board/polyvection/polycore1/imximage.cfg,MX6UL"
CONFIG_ARM=y
CONFIG_ARCH_MX6=y
CONFIG_MX6=y
CONFIG_DM=y
CONFIG_DM_THERMAL=y
CONFIG_TARGET_POLYCORE1=y
```

## configs/polydsp1_defconfig
```kconfig
CONFIG_ARM=y
CONFIG_ARCH_MX6=y
CONFIG_TARGET_POLYDSP1=y
CONFIG_SYS_EXTRA_OPTIONS="IMX_CONFIG=board/polyvection/polydsp1/imximage.cfg"
CONFIG_CMD_GPIO=y
CONFIG_CMD_DHCP=y
CONFIG_CMD_PING=y
```

## configs/voltastream0_defconfig
```kconfig
CONFIG_ARM=y
CONFIG_ARCH_MX6=y
CONFIG_TARGET_VOLTASTREAM0=y
CONFIG_SYS_EXTRA_OPTIONS="IMX_CONFIG=board/polyvection/voltastream0/imximage.cfg"
CONFIG_CMD_GPIO=y
CONFIG_CMD_DHCP=y
CONFIG_CMD_PING=y
```
